## rxos/configs/dc_board_defconfig
```kconfig
BR2_arm=y
BR2_cortex_a8=y
BR2_ARM_FPU_NEON=y
BR2_PRIMARY_SITE="https://archive.outernet.is/sources"
BR2_CCACHE=y
BR2_OPTIMIZE_3=y
BR2_PACKAGE_OVERRIDE_FILE="$(BR2_EXTERNAL)/local.mk"
BR2_GLOBAL_PATCH_DIR="$(BR2_EXTERNAL)/patches/any $(BR2_EXTERNAL)/patches/$(BOARD)"
BR2_TOOLCHAIN_BUILDROOT_VENDOR="outernet"
BR2_KERNEL_HEADERS_4_4=y
BR2_TOOLCHAIN_BUILDROOT_GLIBC=y
BR2_TOOLCHAIN_BUILDROOT_CXX=y
BR2_GENERATE_LOCALE="en_US"
BR2_TARGET_LDFLAGS="-Wl,--build-id=none"
BR2_TARGET_GENERIC_HOSTNAME="$(PRODUCT)"
BR2_TARGET_GENERIC_ISSUE="Welcome to Outernet"
BR2_ROOTFS_DEVICE_CREATION_DYNAMIC_EUDEV=y
# BR2_TARGET_ENABLE_ROOT_LOGIN is not set
BR2_TARGET_GENERIC_GETTY_PORT="tty1"
# BR2_TARGET_GENERIC_REMOUNT_ROOTFS_RW is not set
BR2_TARGET_TZ_INFO=y
BR2_ROOTFS_USERS_TABLES="$(BR2_EXTERNAL)/configs/users"
BR2_ROOTFS_OVERLAY="$(BR2_EXTERNAL)/rootfs/any $(BR2_EXTERNAL)/rootfs/chip"
BR2_LINUX_KERNEL=y
BR2_LINUX_KERNEL_CUSTOM_VERSION=y
BR2_LINUX_KERNEL_CUSTOM_VERSION_VALUE="4.9.8"
BR2_LINUX_KERNEL_USE_CUSTOM_CONFIG=y
BR2_LINUX_KERNEL_CUSTOM_CONFIG_FILE="$(BR2_EXTERNAL)/configs/$(BOARD)_kernel_defconfig"
BR2_LINUX_KERNEL_XZ=y
BR2_LINUX_KERNEL_DTS_SUPPORT=y
BR2_LINUX_KERNEL_INTREE_DTS_NAME="sun5i-a13-olinuxino"
BR2_PACKAGE_BUSYBOX_CONFIG="$(BR2_EXTERNAL)/configs/busybox.config"
BR2_PACKAGE_ALSA_UTILS=y
BR2_PACKAGE_ALSA_UTILS_AMIDI=y
BR2_PACKAGE_ALSA_UTILS_AMIXER=y
BR2_PACKAGE_ALSA_UTILS_APLAY=y
BR2_PACKAGE_ALSA_UTILS_APLAYMIDI=y
BR2_PACKAGE_ALSA_UTILS_SPEAKER_TEST=y
BR2_PACKAGE_ESPEAK=y
BR2_PACKAGE_ESPEAK_AUDIO_BACKEND_ALSA=y
BR2_PACKAGE_OPUS_TOOLS=y
BR2_PACKAGE_SOX=y
BR2_PACKAGE_XZ=y
BR2_PACKAGE_ZIP=y
BR2_PACKAGE_JQ=y
# BR2_PACKAGE_E2FSPROGS_BADBLOCKS is not set
# BR2_PACKAGE_E2FSPROGS_CHATTR is not set
# BR2_PACKAGE_E2FSPROGS_DUMPE2FS is not set
# BR2_PACKAGE_E2FSPROGS_E2FREEFRAG is not set
# BR2_PACKAGE_E2FSPROGS_E2LABEL is not set
# BR2_PACKAGE_E2FSPROGS_E2UNDO is not set
# BR2_PACKAGE_E2FSPROGS_FILEFRAG is not set
# BR2_PACKAGE_E2FSPROGS_FINDFS is not set
# BR2_PACKAGE_E2FSPROGS_LOGSAVE is not set
# BR2_PACKAGE_E2FSPROGS_LSATTR is not set
# BR2_PACKAGE_E2FSPROGS_MKLOSTFOUND is not set
# BR2_PACKAGE_E2FSPROGS_TUNE2FS is not set
# BR2_PACKAGE_E2FSPROGS_UUIDGEN is not set
BR2_PACKAGE_F2FS_TOOLS=y
BR2_PACKAGE_LINUX_FIRMWARE=y
BR2_PACKAGE_LINUX_FIRMWARE_MEDIATEK_MT7601U=y
BR2_PACKAGE_NODEJS_MODULES_ADDITIONAL="bcryptjs@2.4.0 child_process@1.0.2 colors@1.1.2 deepmerge@1.3.1 diskspace@1.0.3 exif@0.6.0 findit@2.0.0 formidable@1.0.17 fs@0.0.1-security http@0.0.0 http-proxy@1.16.2 mysql@2.12.0 net@1.0.2 network@0.3.0 node-fs-extra@0.8.1 passwd-linux@1.3.1 path@0.12.7 querystring@0.2.0 request@2.79.0 simple-session@0.0.1 unix-dgram@1.0.0 unzip@0.1.11 url@0.11.0 userid@0.2.0 util@0.10.3 ws@1.1.1 x2js@3.1.0"
BR2_PACKAGE_LIBCODEC2=y
BR2_PACKAGE_OPUS_FIXED_POINT=y
BR2_PACKAGE_OPUSFILE=y
BR2_PACKAGE_SPEEX=y
BR2_PACKAGE_LZO=y
BR2_PACKAGE_OPENSSL_BIN=y
BR2_PACKAGE_LIBUSB=y
BR2_PACKAGE_LIBEVENT=y
BR2_PACKAGE_LIBGLIB2=y
BR2_PACKAGE_LIBPTHSEM=y
BR2_PACKAGE_LIBPTHSEM_COMPAT=y
BR2_PACKAGE_CRDA=y
# BR2_PACKAGE_DNSMASQ_TFTP is not set
BR2_PACKAGE_DROPBEAR_DISABLE_REVERSEDNS=y
BR2_PACKAGE_DROPBEAR_LASTLOG=y
BR2_PACKAGE_RSYNC=y
BR2_PACKAGE_SUDO=y
BR2_PACKAGE_TAR=y
BR2_TARGET_ROOTFS_INITRAMFS=y
BR2_INITRAMFS_USE_OTHER=y
BR2_CPIO_COMPRESSION_XZ=y
# BR2_TARGET_ROOTFS_TAR is not set
BR2_TARGET_UBOOT=y
BR2_TARGET_UBOOT_BUILD_SYSTEM_KCONFIG=y
BR2_TARGET_UBOOT_CUSTOM_VERSION=y
BR2_TARGET_UBOOT_CUSTOM_VERSION_VALUE="2017.01"
BR2_TARGET_UBOOT_BOARD_DEFCONFIG="A13-OLinuXino"
BR2_TARGET_UBOOT_FORMAT_CUSTOM=y
BR2_TARGET_UBOOT_FORMAT_CUSTOM_NAME="u-boot-sunxi-with-spl.bin"
BR2_TARGET_UBOOT_ENVIMAGE=y
BR2_TARGET_UBOOT_ENVIMAGE_SOURCE="$(BR2_EXTERNAL)/configs/$(BOARD)_uboot_env"
BR2_TARGET_UBOOT_ENVIMAGE_SIZE="0x400000"
BR2_PACKAGE_HOST_DOS2UNIX=y
BR2_PACKAGE_HOST_DTC=y
RXOS_SUBPLATFORM="$(BOARD)"
RXOS_VERSION="4.4"
RXOS_TMPFS_SIZE=16
BR2_PACKAGE_SD_IMAGE=y
BR2_PACKAGE_SOP_HANDLER=y
BR2_PATH_BLACKLIST="^.platform(/.*)?$$ ^(.*/)?.thumbs(/.*)?$$ ^updates(/.*)?$$ ^legacy(/.*)?$$ ^FSCK.*.REC$$"
BR2_RAMFSINIT_SDCARD=y
BR2_PACKAGE_BOOTHOOK_SELFPARTITION=y
BR2_BOOTHOOK_SELFPARTITION_CONFIG_SIZE="64"
BR2_PACKAGE_PERSIST_CONF=y
BR2_PERSISTENT_CONF_LIST="/etc/shadow"
BR2_PACKAGE_REMOTE_SUPPORT=y
BR2_PACKAGE_GSERIAL=y
BR2_PACKAGE_STORAGE_HOTPLUG=y
BR2_PACKAGE_DROPBEAR_INIT=y
BR2_PACKAGE_NETWORK_CONFIG=y
BR2_NETWORK_CONFIG_HAS_ETH=y
BR2_NETWORK_CONFIG_HAS_GETH=y
BR2_NETWORK_CONFIG_WLAN_NOPOWERSAVE=y
BR2_PACKAGE_CLEANUP=y
BR2_PACKAGE_SDR_CONFIG=y
BR2_SDR_BINARY_PATH="/opt/sdr/demod"
BR2_PACKAGE_ONDD=y
BR2_ONDD_CONFIGFILE="/mnt/data/ondd.conf"
BR2_ONDD_INSTALL_TARBALL=y
BR2_PACKAGE_STARSDR_ARM=y
BR2_PACKAGE_OPAKWATCH2=y
BR2_OPAKWATCH2_SOURCE="/mnt/downloads/opaks"
BR2_PACKAGE_WEATHERGEN=y
BR2_WEATHERGEN_SOURCE="/mnt/downloads/grib2"
BR2_PACKAGE_UI2SERVICE=y
BR2_PACKAGE_VSFTPD_RXOS=y
BR2_LED_CONTROL_I2C=y
BR2_PACKAGE_TWEETNACL_TOOLS=y
BR2_PACKAGE_RXOS_UTILS=y
BR2_RXOS_UTILS_INSTALL_CHIPGPIO=y
BR2_RXOS_UTILS_PROCS="hostapd dnsmasq dropbear ondd demod vsftpd inotifywait node"
BR2_RXOS_UTILS_HOSTS="HTTP:http:80"
BR2_RXOS_UTILS_EXTRA_PATH="/mnt/conf"
BR2_PACKAGE_MT7601APSTA=y
```

## rxos/configs/rpi3_board_defconfig
```kconfig
BR2_arm=y
BR2_cortex_a7=y
BR2_ARM_FPU_NEON_VFPV4=y
BR2_PRIMARY_SITE="https://archive.outernet.is/sources"
BR2_GLOBAL_PATCH_DIR="$(BR2_EXTERNAL)/patches/any $(BR2_EXTERNAL)/patches/rpi3"
BR2_KERNEL_HEADERS_4_1=y
BR2_TOOLCHAIN_BUILDROOT_GLIBC=y
BR2_TOOLCHAIN_BUILDROOT_CXX=y
BR2_GENERATE_LOCALE="en_US"
BR2_TARGET_GENERIC_HOSTNAME="rxos"
BR2_TARGET_GENERIC_ISSUE="Welcome to Outernet"
BR2_ROOTFS_DEVICE_CREATION_DYNAMIC_EUDEV=y
# BR2_TARGET_ENABLE_ROOT_LOGIN is not set
BR2_TARGET_GENERIC_GETTY_PORT="tty1"
# BR2_TARGET_GENERIC_REMOUNT_ROOTFS_RW is not set
BR2_TARGET_TZ_INFO=y
BR2_ROOTFS_USERS_TABLES="$(BR2_EXTERNAL)/configs/users"
BR2_ROOTFS_OVERLAY="$(BR2_EXTERNAL)/rootfs/any $(BR2_EXTERNAL)/rootfs/rpi3"
BR2_ROOTFS_POST_BUILD_SCRIPT="$(BR2_EXTERNAL)/scripts/collect_static.sh"
BR2_ROOTFS_POST_IMAGE_SCRIPT="$(BR2_EXTERNAL)/scripts/add_trailer.sh $(BR2_EXTERNAL)/scripts/filelist.sh"
BR2_LINUX_KERNEL=y
BR2_LINUX_KERNEL_CUSTOM_TARBALL=y
BR2_LINUX_KERNEL_CUSTOM_TARBALL_LOCATION="https://archive.outernet.is/sources/linux-rpi-4.1.y.tar.gz"
BR2_LINUX_KERNEL_USE_CUSTOM_CONFIG=y
BR2_LINUX_KERNEL_CUSTOM_CONFIG_FILE="$(BR2_EXTERNAL)/configs/rpi3_kernel_defconfig"
BR2_LINUX_KERNEL_DTS_SUPPORT=y
BR2_LINUX_KERNEL_INTREE_DTS_NAME="bcm2710-rpi-3-b"
BR2_PACKAGE_BUSYBOX_CONFIG="$(BR2_EXTERNAL)/configs/busybox.config"
BR2_PACKAGE_BZIP2=y
BR2_PACKAGE_ZIP=y
# BR2_PACKAGE_E2FSPROGS_BADBLOCKS is not set
# BR2_PACKAGE_E2FSPROGS_CHATTR is not set
# BR2_PACKAGE_E2FSPROGS_DUMPE2FS is not set
# BR2_PACKAGE_E2FSPROGS_E2FREEFRAG is not set
# BR2_PACKAGE_E2FSPROGS_E2UNDO is not set
# BR2_PACKAGE_E2FSPROGS_FILEFRAG is not set
# BR2_PACKAGE_E2FSPROGS_FINDFS is not set
# BR2_PACKAGE_E2FSPROGS_LOGSAVE is not set
# BR2_PACKAGE_E2FSPROGS_LSATTR is not set
BR2_PACKAGE_MTD=y
BR2_PACKAGE_RPI_FIRMWARE=y
# BR2_PACKAGE_RPI_FIRMWARE_INSTALL_DTB_OVERLAYS is not set
BR2_PACKAGE_PYTHON=y
BR2_PACKAGE_PYTHON_PY_ONLY=y
BR2_PACKAGE_PYTHON_READLINE=y
BR2_PACKAGE_PYTHON_SSL=y
BR2_PACKAGE_PYTHON_SQLITE=y
BR2_PACKAGE_PYTHON_HASHLIB=y
BR2_PACKAGE_PYTHON_PYYAML=y
BR2_PACKAGE_LIBRTLSDR=y
BR2_PACKAGE_LIBXML2=y
BR2_PACKAGE_LIBGLIB2=y
BR2_PACKAGE_CRDA=y
# BR2_PACKAGE_DNSMASQ_TFTP is not set
BR2_PACKAGE_DROPBEAR_DISABLE_REVERSEDNS=y
BR2_PACKAGE_DROPBEAR_LASTLOG=y
BR2_PACKAGE_NTP=y
BR2_PACKAGE_SUDO=y
BR2_TARGET_ROOTFS_INITRAMFS=y
BR2_INITRAMFS_USE_OTHER=y
BR2_CPIO_COMPRESSION_LZ4=y
BR2_TARGET_ROOTFS_SQUASHFS=y
BR2_TARGET_ROOTFS_SQUASHFS4_LZ4=y
BR2_PACKAGE_HOST_DOS2UNIX=y
RXOS_SUBPLATFORM="rpi3"
RXOS_VERSION="2.0"
RXOS_TMPFS_SIZE=100
BR2_PACKAGE_SDIMAGE=y
BR2_SDIMAGE_SOURCE="$(BR2_EXTERNAL)/configs/sdimage.txt"
BR2_PACKAGE_OTA_PKG=y
BR2_PATH_BLACKLIST="^.platform(/.*)?$$ ^(.*/)?.thumbs(/.*)?$$ ^updates(/.*)?$$ ^legacy(/.*)?$$ ^FSCK.*.REC$$"
BR2_RAMFSINIT_SDCARD=y
BR2_PACKAGE_BOOTHOOK_SELFPARTITION=y
BR2_PACKAGE_PERSIST_CONF=y
BR2_PERSISTENT_CONF_LIST="/etc/passwd /etc/shadow /etc/group"
BR2_PACKAGE_REMOTE_SUPPORT=y
BR2_PACKAGE_STORAGE_HOTPLUG=y
BR2_STORAGE_HOTPLUG_CHECK_PKG=y
BR2_PACKAGE_DROPBEAR_INIT=y
BR2_PACKAGE_NETWORK_CONFIG=y
BR2_NETWORK_CONFIG_HAS_ETH=y
BR2_NETWORK_CONFIG_TAG="outernet"
BR2_PACKAGE_SDR_CONFIG=y
BR2_SDR_BINARY_PATH="/opt/sdr/demod"
BR2_ONDD_CONFIGFILE="/mnt/data/ondd.conf"
BR2_ONDD_INSTALL_TARBALL=y
BR2_PACKAGE_LIBRARIAN_CONFIG=y
BR2_LIBRARIAN_TMPDIR="/mnt/data/tmp"
BR2_PACKAGE_TELEMETRY=y
BR2_PACKAGE_PYTHON_LFTP=y
BR2_PACKAGE_PYTHON_LIBRARIAN_NETINTERFACES=y
BR2_PACKAGE_PYTHON_LIBRARIAN_SVM=y
BR2_PACKAGE_LIGHTTPD_CONFIG=y
BR2_LIGHTTPD_UPLOAD_TMPDIR="/mnt/data/tmp"
BR2_PACKAGE_POSTGRES_CONFIG=y
BR2_PACKAGE_LIGHTTPD_CUSTOM_PCRE=y
BR2_PACKAGE_MULTIFS=y
BR2_PACKAGE_RXOS_UTILS=y
BR2_RXOS_UTILS_IFACES="wlan0 eth0"
BR2_PACKAGE_FIRMWARE_BRCMFMAC43430_SDIO=y
```

## rxos/configs/rxos_defconfig
```kconfig
BR2_arm=y
BR2_cortex_a8=y
BR2_PRIMARY_SITE="https://archive.outernet.is/sources"
BR2_GLOBAL_PATCH_DIR="$(BR2_EXTERNAL)/patches"
BR2_KERNEL_HEADERS_VERSION=y
BR2_DEFAULT_KERNEL_VERSION="4.2.1"
BR2_PACKAGE_HOST_LINUX_HEADERS_CUSTOM_4_2=y
BR2_TOOLCHAIN_BUILDROOT_GLIBC=y
BR2_TOOLCHAIN_BUILDROOT_CXX=y
BR2_GENERATE_LOCALE="en_US"
BR2_TARGET_GENERIC_HOSTNAME="rxos"
BR2_TARGET_GENERIC_ISSUE="Welcome to Outernet"
BR2_ROOTFS_DEVICE_CREATION_DYNAMIC_EUDEV=y
# BR2_TARGET_ENABLE_ROOT_LOGIN is not set
BR2_TARGET_GENERIC_GETTY_PORT="tty1"
# BR2_TARGET_GENERIC_REMOUNT_ROOTFS_RW is not set
BR2_TARGET_TZ_INFO=y
BR2_ROOTFS_USERS_TABLES="$(BR2_EXTERNAL)/configs/users"
BR2_ROOTFS_OVERLAY="$(BR2_EXTERNAL)/rootfs"
BR2_ROOTFS_POST_BUILD_SCRIPT="$(BR2_EXTERNAL)/scripts/collect_static.sh"
BR2_ROOTFS_POST_IMAGE_SCRIPT="$(BR2_EXTERNAL)/scripts/filelist.sh"
BR2_LINUX_KERNEL=y
BR2_LINUX_KERNEL_CUSTOM_TARBALL=y
BR2_LINUX_KERNEL_CUSTOM_TARBALL_LOCATION="https://archive.outernet.is/sources/linux-chip-4.2.y.tar.gz"
BR2_LINUX_KERNEL_USE_CUSTOM_CONFIG=y
BR2_LINUX_KERNEL_CUSTOM_CONFIG_FILE="$(BR2_EXTERNAL)/configs/rxos_kernel_defconfig"
BR2_LINUX_KERNEL_APPENDED_ZIMAGE=y
BR2_LINUX_KERNEL_INTREE_DTS_NAME="sun5i-r8-chip"
BR2_PACKAGE_BUSYBOX_CONFIG="$(BR2_EXTERNAL)/configs/busybox.config"
BR2_PACKAGE_BZIP2=y
BR2_PACKAGE_ZIP=y
# BR2_PACKAGE_E2FSPROGS_BADBLOCKS is not set
# BR2_PACKAGE_E2FSPROGS_CHATTR is not set
# BR2_PACKAGE_E2FSPROGS_DUMPE2FS is not set
# BR2_PACKAGE_E2FSPROGS_E2FREEFRAG is not set
# BR2_PACKAGE_E2FSPROGS_E2LABEL is not set
# BR2_PACKAGE_E2FSPROGS_E2UNDO is not set
# BR2_PACKAGE_E2FSPROGS_FILEFRAG is not set
# BR2_PACKAGE_E2FSPROGS_FINDFS is not set
# BR2_PACKAGE_E2FSPROGS_LOGSAVE is not set
# BR2_PACKAGE_E2FSPROGS_LSATTR is not set
# BR2_PACKAGE_E2FSPROGS_MKE2FS is not set
# BR2_PACKAGE_E2FSPROGS_MKLOSTFOUND is not set
# BR2_PACKAGE_E2FSPROGS_TUNE2FS is not set
# BR2_PACKAGE_E2FSPROGS_UUIDGEN is not set
# BR2_PACKAGE_MTD_FLASHCP is not set
# BR2_PACKAGE_MTD_FLASH_ERASE is not set
# BR2_PACKAGE_MTD_FLASH_LOCK is not set
# BR2_PACKAGE_MTD_FLASH_UNLOCK is not set
# BR2_PACKAGE_MTD_MTD_DEBUG is not set
# BR2_PACKAGE_MTD_NANDDUMP is not set
# BR2_PACKAGE_MTD_NANDTEST is not set
# BR2_PACKAGE_MTD_NANDWRITE is not set
# BR2_PACKAGE_MTD_MTDINFO is not set
# BR2_PACKAGE_MTD_UBIATTACH is not set
# BR2_PACKAGE_MTD_UBICRC32 is not set
# BR2_PACKAGE_MTD_UBIDETACH is not set
# BR2_PACKAGE_MTD_UBIFORMAT is not set
# BR2_PACKAGE_MTD_UBINIZE is not set
# BR2_PACKAGE_MTD_UBIRENAME is not set
# BR2_PACKAGE_MTD_UBIRMVOL is not set
# BR2_PACKAGE_MTD_UBIRSVOL is not set
# BR2_PACKAGE_MTD_UBIUPDATEVOL is not set
# BR2_PACKAGE_MTD_UBIBLOCK is not set
BR2_PACKAGE_RPI_FIRMWARE=y
# BR2_PACKAGE_RPI_FIRMWARE_INSTALL_DTB_OVERLAYS is not set
BR2_PACKAGE_PYTHON=y
BR2_PACKAGE_PYTHON_PY_ONLY=y
BR2_PACKAGE_PYTHON_READLINE=y
BR2_PACKAGE_PYTHON_SSL=y
BR2_PACKAGE_PYTHON_SQLITE=y
BR2_PACKAGE_PYTHON_HASHLIB=y
BR2_PACKAGE_LIBRTLSDR=y
BR2_PACKAGE_LIBXML2=y
BR2_PACKAGE_LIBGLIB2=y
BR2_PACKAGE_CRDA=y
# BR2_PACKAGE_DNSMASQ_TFTP is not set
# BR2_PACKAGE_DROPBEAR_CLIENT is not set
BR2_PACKAGE_DROPBEAR_DISABLE_REVERSEDNS=y
BR2_PACKAGE_DROPBEAR_LASTLOG=y
BR2_PACKAGE_NTP=y
BR2_PACKAGE_SUDO=y
BR2_INITRAMFS_USE_OTHER=y
BR2_CPIO_COMPRESSION_LZ4=y
BR2_TARGET_ROOTFS_UBIFS=y
BR2_TARGET_ROOTFS_UBIFS_LEBSIZE=0x1f8000
BR2_TARGET_ROOTFS_UBIFS_MINIOSIZE=0x4000
BR2_TARGET_ROOTFS_UBIFS_MAXLEBCNT=2000
BR2_TARGET_ROOTFS_UBIFS_LZO=y
BR2_TARGET_ROOTFS_UBI=y
BR2_TARGET_ROOTFS_UBI_SUBSIZE=16384
BR2_TARGET_UBOOT=y
BR2_TARGET_UBOOT_BOARDNAME="CHIP"
BR2_TARGET_UBOOT_CUSTOM_TARBALL=y
BR2_TARGET_UBOOT_CUSTOM_TARBALL_LOCATION="https://archive.outernet.is/sources/u-boot-chip-2015.07.tar.gz"
BR2_TARGET_UBOOT_FORMAT_CUSTOM=y
BR2_TARGET_UBOOT_FORMAT_CUSTOM_NAME="u-boot-dtb.bin"
BR2_TARGET_UBOOT_SPL=y
BR2_TARGET_UBOOT_SPL_NAME="spl/sunxi-spl.bin"
BR2_TARGET_UBOOT_ENVIMAGE=y
BR2_TARGET_UBOOT_ENVIMAGE_SOURCE="$(BR2_EXTERNAL)/configs/rxos_uboot-env"
BR2_TARGET_UBOOT_ENVIMAGE_SIZE="0x400000"
BR2_PACKAGE_HOST_DOS2UNIX=y
BR2_PACKAGE_HOST_DOSFSTOOLS=y
BR2_PACKAGE_HOST_MTOOLS=y
BR2_PACKAGE_HOST_UTIL_LINUX=y
RXOS_VERSION="1.0rc1"
BR2_PATH_BLACKLIST="^.platform(/.*)?$$ ^(.*/)?.thumbs(/.*)?$$ ^updates(/.*)?$$ ^legacy(/.*)?$$ ^FSCK.*.REC$$"
BR2_PACKAGE_BOOTHOOK_SELFPARTITION=y
BR2_PACKAGE_PERSIST_CONF=y
BR2_PERSISTENT_CONF_LIST="$(BR2_EXTERNAL)/configs/persist.conf"
BR2_PACKAGE_STORAGE_HOTPLUG=y
BR2_PACKAGE_DROPBEAR_INIT=y
BR2_PACKAGE_NETWORK_CONFIG=y
BR2_PACKAGE_LIBRARIAN_CONFIG=y
BR2_PACKAGE_MONITORING=y
BR2_MONITORING_PERSISTDIR="/mnt/data"
BR2_PACKAGE_PYTHON_LIBRARIAN_UI=y
BR2_PACKAGE_PYTHON_LIBRARIAN_LOGS=y
BR2_PACKAGE_PYTHON_LIBRARIAN_DISKSPACE=y
BR2_PACKAGE_PYTHON_LIBRARIAN_NETINTERFACES=y
BR2_PACKAGE_PYTHON_LIBRARIAN_ONDD=y
BR2_PACKAGE_PYTHON_LIBRARIAN_SETTINGS=y
BR2_PACKAGE_PYTHON_LIBRARIAN_FILEMANAGER=y
BR2_PACKAGE_PYTHON_LFTP=y
BR2_PACKAGE_PYTHON_LIBRARIAN_TWITTER=y
BR2_PACKAGE_PYTHON_LIBRARIAN_ANALYTICS=y
BR2_PACKAGE_PYTHON_LIBRARIAN_CAPTIVE=y
BR2_PACKAGE_LIGHTTPD_CONFIG=y
BR2_PACKAGE_POSTGRES_CONFIG=y
BR2_PACKAGE_LIGHTTPD_CUSTOM_PCRE=y
BR2_PACKAGE_RXOS_UTILS=y
BR2_PACKAGE_FIRMWARE_MT7601U=y
```

## rxos/local/audio-service/Config.in
```kconfig
config BR2_PACKAGE_AUDIO_SERVICE
	bool "Audio service"
	help
	  Audio service plays audio files over the local audio-out port
```

## rxos/local/battmon/Config.in
```kconfig
config BR2_PACKAGE_BATTMON
	bool "Monitor battery state"
	select BR2_PACKAGE_BC
	select BR2_PACKAGE_I2C_TOOLS
	help
	  This package installs a system service that 
	  monitors battery charge state and voltage
	  and reports abnormalities by flashing the
	  status LED.
```

## rxos/local/boothook-gserial/Config.in
```kconfig
config BR2_PACKAGE_BOOTHOOK_GSERIAL
	bool "Enable support for gadget serial/network"
	help
	  Enable support for gadget serial

	  https://outernet.is/
```
