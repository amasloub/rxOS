## rxos/Config.in
```kconfig
menu "Firmware configuration"

	config RXOS_PLATFORM
		string "Platform name"
		default BR2_TARGET_GENERIC_HOSTNAME
		help
		  Name of the platform

	config RXOS_VERSION
		string "Platform version"
		default 0.0
		help
		  Platform version

	config RXOS_TMPFS_SIZE
		string "Size of the rootfs RAM disk overlay in MiB"
		default 60
		help
		  Because root filesystem is mounted read-only a 
		  RAM disk overlay is used to provide a write layer
		  at runtime. This setting determines the size of 
		  the RAM disk. Note that this is also the portion
		  of the RAM that becomes inaccessible to the 
		  applications.

	menuconfig RXOS_BUILD_SDIMAGE
		bool "Build SD card image"
		select BR2_PACKAGE_HOST_DIR2FAT32
		help
		  Build and SD card image containing the boot files
		  (bootloader, firmware, kernel image, rootfs images).

	if RXOS_BUILD_SDIMAGE

		config RXOS_SDIMAGE_FILE
			string "Output filename"
			default "sdcard.img"
			help
			  Name of the output image file. The file will
			  be stored in the $BINARIES_DIR.
		
		config RXOS_SDIMAGE_SIZE
		string "Boot partition size in MiB"
		default 200
		help
		  Size of the FAT32 partition that will store the 
		  boot files.

		config RXOS_SDIMAGE_SOURCE
		string "File containing the file list for SD card image"
		help
		  The file should be in the following format:

		      source_path:target_path

		  The source_path points to the file within the 
		  $BINARIES_DIR, and the target_path points to the
		  intended path within the SD card.

	endif # RXOS_BUILD_SDIMAGE

	source "$BR2_EXTERNAL/local/ubi-image/Config.in"
	source "$BR2_EXTERNAL/local/ota-pkg/Config.in"

endmenu

menu "System configuration"
	config BR2_STORAGE_PRIMARY
		string "Primary download storage location"
		default "/mnt/downloads"
		help
		  Directory of the primary (internal) download
		  storage.

	config BR2_STORAGE_SECONDARY
		string "External download storage location"
		default "/mnt/external"
		help
		  Directory of the secondary (external) download
		  storage.

	config BR2_PATH_BLACKLIST
		string "Path blacklist for FSAL and FTP"
		default "^\.platform(/.*)?$$ ^(.*/)?.thumbs(/.*)?$$ ^updates(/.*)?$$ ^legacy(/.*)?$$ ^FSCK.*\.REC$$ ^lost+found$$"
		help
		  Python regexp patterns that black-list paths.
		  Note that '$$' is used instead of '$'

	source "$BR2_EXTERNAL/local/ramfsinit/Config.in"
	source "$BR2_EXTERNAL/local/boothook-selfpartition/Config.in"
	source "$BR2_EXTERNAL/local/setup/Config.in"
	source "$BR2_EXTERNAL/local/persist-conf/Config.in"
	source "$BR2_EXTERNAL/local/remote-support/Config.in"
	source "$BR2_EXTERNAL/local/gserial/Config.in"
	source "$BR2_EXTERNAL/local/storage-hotplug/Config.in"
endmenu

menu "Network configuration"
	source "$BR2_EXTERNAL/local/dropbear-init/Config.in"
	source "$BR2_EXTERNAL/local/network-config/Config.in"
endmenu

menu "Data services"
	source "$BR2_EXTERNAL/local/sdr-config/Config.in"
	source "$BR2_EXTERNAL/package/ondd/Config.in"
	source "$BR2_EXTERNAL/package/python-fsal/Config.in"
endmenu

menu "Applications"
	source "$BR2_EXTERNAL/local/librarian-config/Config.in"
	source "$BR2_EXTERNAL/local/fsal-config/Config.in"
	source "$BR2_EXTERNAL/package/python-librarian/Config.in"
	source "$BR2_EXTERNAL/package/monitoring/Config.in"
	comment "Content access"
		source "$BR2_EXTERNAL/package/python-lftp/Config.in"
	comment "Network"
		source "$BR2_EXTERNAL/package/python-librarian-netinterfaces/Config.in"
	comment "Misc"
		source "$BR2_EXTERNAL/package/python-librarian-analytics/Config.in"
		source "$BR2_EXTERNAL/package/python-librarian-sdr/Config.in"
endmenu

menu "Libraries"
    source "$BR2_EXTERNAL/package/python-bitarray/Config.in"
    source "$BR2_EXTERNAL/package/python-bitpack/Config.in"
    source "$BR2_EXTERNAL/package/python-bottle-fdsend/Config.in"
    source "$BR2_EXTERNAL/package/python-bottle-streamline/Config.in"
    source "$BR2_EXTERNAL/package/python-bottle-utils/Config.in"
    source "$BR2_EXTERNAL/package/python-chainable-validators/Config.in"
    source "$BR2_EXTERNAL/package/python-cssmin/Config.in"
    source "$BR2_EXTERNAL/package/python-confloader/Config.in"
    source "$BR2_EXTERNAL/package/python-dateutil/Config.in"
    source "$BR2_EXTERNAL/package/python-disentangler/Config.in"
    source "$BR2_EXTERNAL/package/python-gevent/Config.in"
    source "$BR2_EXTERNAL/package/python-greenlet/Config.in"
    source "$BR2_EXTERNAL/package/python-greentasks/Config.in"
    source "$BR2_EXTERNAL/package/python-hwd/Config.in"
    source "$BR2_EXTERNAL/package/python-ondd-ipc/Config.in"
    source "$BR2_EXTERNAL/package/python-pbkdf2/Config.in"
    source "$BR2_EXTERNAL/package/python-pyhostapdconf/Config.in"
    source "$BR2_EXTERNAL/package/python-pytz/Config.in"
    source "$BR2_EXTERNAL/package/python-scandir/Config.in"
    source "$BR2_EXTERNAL/package/python-sqlize-pg/Config.in"
    source "$BR2_EXTERNAL/package/python-squery-pg/Config.in"
    source "$BR2_EXTERNAL/package/python-webassets/Config.in"
    source "$BR2_EXTERNAL/package/python-psycopg2/Config.in"
    source "$BR2_EXTERNAL/package/python-ua-parser/Config.in"
    source "$BR2_EXTERNAL/package/python-user-agents/Config.in"
    source "$BR2_EXTERNAL/package/python-zippie/Config.in"
endmenu

menu "Servers"
    source "$BR2_EXTERNAL/local/nginx-config/Config.in"
    source "$BR2_EXTERNAL/local/lighttpd-config/Config.in"
    source "$BR2_EXTERNAL/local/postgres-config/Config.in"
    source "$BR2_EXTERNAL/package/lighttpd-custom/Config.in"
    source "$BR2_EXTERNAL/package/postgresql-95/Config.in"
endmenu

menu "Utilities"
    source "$BR2_EXTERNAL/local/led-control/Config.in"
    source "$BR2_EXTERNAL/package/pkgtool/Config.in"
    source "$BR2_EXTERNAL/local/rxos-utils/Config.in"
endmenu

menu "Host utilities"
	source "$BR2_EXTERNAL/package/dir2fat32/Config.in.host"
    source "$BR2_EXTERNAL/package/pkgtool/Config.in.host"
endmenu

menu "Hardware support"
    source "$BR2_EXTERNAL/package/firmware-brcmfmac43430-sdio/Config.in"
    source "$BR2_EXTERNAL/package/firmware-mt7601u-usb/Config.in"
    source "$BR2_EXTERNAL/package/firmware-mt7601u-usb/Config.in"
    source "$BR2_EXTERNAL/package/rtl8723bs/Config.in"
    source "$BR2_EXTERNAL/package/rtl8723bs_bt/Config.in"
endmenu
```

## rxos/configs/chip_board_defconfig
```kconfig
BR2_arm=y
BR2_cortex_a8=y
BR2_PRIMARY_SITE="https://archive.outernet.is/sources"
BR2_CCACHE=y
BR2_OPTIMIZE_3=y
BR2_PACKAGE_OVERRIDE_FILE="$(BR2_EXTERNAL)/local.mk"
BR2_GLOBAL_PATCH_DIR="$(BR2_EXTERNAL)/patches/any $(BR2_EXTERNAL)/patches/chip"
BR2_KERNEL_HEADERS_4_4=y
BR2_TOOLCHAIN_BUILDROOT_GLIBC=y
BR2_TOOLCHAIN_BUILDROOT_CXX=y
BR2_GENERATE_LOCALE="en_US"
BR2_TARGET_GENERIC_HOSTNAME="skylark"
BR2_TARGET_GENERIC_ISSUE="Welcome to Outernet"
BR2_ROOTFS_DEVICE_CREATION_DYNAMIC_EUDEV=y
# BR2_TARGET_ENABLE_ROOT_LOGIN is not set
BR2_TARGET_GENERIC_GETTY_PORT="tty1"
# BR2_TARGET_GENERIC_REMOUNT_ROOTFS_RW is not set
BR2_TARGET_TZ_INFO=y
BR2_ROOTFS_USERS_TABLES="$(BR2_EXTERNAL)/configs/users"
BR2_ROOTFS_OVERLAY="$(BR2_EXTERNAL)/rootfs/any $(BR2_EXTERNAL)/rootfs/chip"
BR2_ROOTFS_POST_IMAGE_SCRIPT="$(BR2_EXTERNAL)/scripts/filelist.sh"
BR2_LINUX_KERNEL=y
BR2_LINUX_KERNEL_CUSTOM_GIT=y
BR2_LINUX_KERNEL_CUSTOM_REPO_URL="https://github.com/Outernet-Project/CHIP-linux"
BR2_LINUX_KERNEL_CUSTOM_REPO_VERSION="103b79e"
BR2_LINUX_KERNEL_USE_CUSTOM_CONFIG=y
BR2_LINUX_KERNEL_CUSTOM_CONFIG_FILE="$(BR2_EXTERNAL)/configs/chip_kernel_defconfig"
BR2_LINUX_KERNEL_DTS_SUPPORT=y
BR2_LINUX_KERNEL_INTREE_DTS_NAME="sun5i-r8-chip"
BR2_PACKAGE_BUSYBOX_CONFIG="$(BR2_EXTERNAL)/configs/busybox.config"
BR2_PACKAGE_ZIP=y
BR2_PACKAGE_BSDIFF=y
BR2_PACKAGE_JQ=y
# BR2_PACKAGE_E2FSPROGS_BADBLOCKS is not set
# BR2_PACKAGE_E2FSPROGS_CHATTR is not set
# BR2_PACKAGE_E2FSPROGS_DUMPE2FS is not set
# BR2_PACKAGE_E2FSPROGS_E2FREEFRAG is not set
# BR2_PACKAGE_E2FSPROGS_E2LABEL is not set
# BR2_PACKAGE_E2FSPROGS_E2UNDO is not set
# BR2_PACKAGE_E2FSPROGS_FILEFRAG is not set
# BR2_PACKAGE_E2FSPROGS_FINDFS is not set
# BR2_PACKAGE_E2FSPROGS_LOGSAVE is not set
# BR2_PACKAGE_E2FSPROGS_LSATTR is not set
# BR2_PACKAGE_E2FSPROGS_MKE2FS is not set
# BR2_PACKAGE_E2FSPROGS_MKLOSTFOUND is not set
# BR2_PACKAGE_E2FSPROGS_TUNE2FS is not set
# BR2_PACKAGE_E2FSPROGS_UUIDGEN is not set
# BR2_PACKAGE_MTD_FLASHCP is not set
# BR2_PACKAGE_MTD_FLASH_ERASE is not set
# BR2_PACKAGE_MTD_FLASH_LOCK is not set
# BR2_PACKAGE_MTD_FLASH_UNLOCK is not set
# BR2_PACKAGE_MTD_MTD_DEBUG is not set
# BR2_PACKAGE_MTD_NANDDUMP is not set
# BR2_PACKAGE_MTD_NANDTEST is not set
# BR2_PACKAGE_MTD_NANDWRITE is not set
# BR2_PACKAGE_MTD_MTDINFO is not set
# BR2_PACKAGE_MTD_UBINIZE is not set
BR2_PACKAGE_NODEJS_NPM=y
BR2_PACKAGE_NODEJS_MODULES_ADDITIONAL="bcryptjs child_process colors diskspace exif findit formidable fs http http-proxy mysql net network node-fs-extra passwd-linux path querystring request simple-session unix-dgram unzip url userid util ws x2js"
BR2_PACKAGE_OPENSSL_BIN=y
BR2_PACKAGE_LIBUSB=y
BR2_PACKAGE_LIBEVENT=y
BR2_PACKAGE_LIBGLIB2=y
BR2_PACKAGE_LIBPTHSEM=y
BR2_PACKAGE_LIBPTHSEM_COMPAT=y
# BR2_PACKAGE_DNSMASQ_TFTP is not set
BR2_PACKAGE_DROPBEAR_DISABLE_REVERSEDNS=y
BR2_PACKAGE_DROPBEAR_LASTLOG=y
BR2_PACKAGE_SUDO=y
BR2_PACKAGE_TAR=y
BR2_TARGET_ROOTFS_INITRAMFS=y
BR2_INITRAMFS_USE_OTHER=y
BR2_CPIO_COMPRESSION_LZ4=y
BR2_TARGET_UBOOT=y
BR2_TARGET_UBOOT_BOARDNAME="CHIP"
BR2_TARGET_UBOOT_CUSTOM_TARBALL=y
BR2_TARGET_UBOOT_CUSTOM_TARBALL_LOCATION="https://archive.outernet.is/sources/u-boot-chip-2016.01-c23364e.tar.gz"
BR2_TARGET_UBOOT_FORMAT_CUSTOM=y
BR2_TARGET_UBOOT_FORMAT_CUSTOM_NAME="u-boot-dtb.bin"
BR2_TARGET_UBOOT_SPL=y
BR2_TARGET_UBOOT_SPL_NAME="spl/sunxi-spl.bin spl/sunxi-spl-with-ecc.bin"
BR2_TARGET_UBOOT_ENVIMAGE=y
BR2_TARGET_UBOOT_ENVIMAGE_SOURCE="$(BR2_EXTERNAL)/configs/chip_uboot_env"
BR2_TARGET_UBOOT_ENVIMAGE_SIZE="0x400000"
BR2_PACKAGE_HOST_DOS2UNIX=y
BR2_PACKAGE_HOST_DOSFSTOOLS=y
BR2_PACKAGE_HOST_DTC=y
BR2_PACKAGE_HOST_MTOOLS=y
BR2_PACKAGE_HOST_UTIL_LINUX=y
RXOS_SUBPLATFORM="chip"
RXOS_VERSION="4.0"
BR2_PACKAGE_UBI_IMAGE=y
BR2_PATH_BLACKLIST="^.platform(/.*)?$$ ^(.*/)?.thumbs(/.*)?$$ ^updates(/.*)?$$ ^legacy(/.*)?$$ ^FSCK.*.REC$$"
BR2_PACKAGE_BOOTHOOK_SELFPARTITION=y
BR2_BOOTHOOK_SELFPARTITION_CONFIG_SIZE="64"
BR2_PACKAGE_PERSIST_CONF=y
BR2_PERSISTENT_CONF_LIST="/etc/passwd /etc/shadow /etc/group"
BR2_PACKAGE_REMOTE_SUPPORT=y
BR2_PACKAGE_GSERIAL=y
BR2_PACKAGE_STORAGE_HOTPLUG=y
BR2_STORAGE_HOTPLUG_CHECK_PKG=y
BR2_PACKAGE_DROPBEAR_INIT=y
BR2_PACKAGE_NETWORK_CONFIG=y
BR2_NETWORK_CONFIG_HAS_ETH=y
BR2_NETWORK_CONFIG_HAS_GETH=y
BR2_NETWORK_CONFIG_WLAN_NOPOWERSAVE=y
BR2_PACKAGE_CLEANUP=y
BR2_PACKAGE_SDR_CONFIG=y
BR2_SDR_BINARY_PATH="/opt/sdr/demod"
BR2_PACKAGE_ONDD=y
BR2_ONDD_CONFIGFILE="/mnt/data/ondd.conf"
BR2_ONDD_INSTALL_TARBALL=y
BR2_PACKAGE_OPAKWATCH2=y
BR2_PACKAGE_WEATHERGEN=y
BR2_PACKAGE_UI2SERVICE=y
BR2_PACKAGE_VSFTPD_RXOS=y
BR2_PACKAGE_MULTIFS=y
BR2_LED_CONTROL_I2C=y
BR2_PACKAGE_TWEETNACL_TOOLS=y
BR2_PACKAGE_RXOS_UTILS=y
BR2_RXOS_UTILS_INSTALL_CHIPGPIO=y
BR2_RXOS_UTILS_PROCS="hostapd dnsmasq dropbear ondd demod vsftpd inotifywait node"
BR2_RXOS_UTILS_HOSTS="HTTP:http:80"
BR2_RXOS_UTILS_EXTRA_PATH="/mnt/conf"
BR2_PACKAGE_HOST_PKGTOOL=y
BR2_PACKAGE_RTL8723BS=y
```
