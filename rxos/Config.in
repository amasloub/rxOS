## rxos/local/boothook-selfpartition/Config.in
```kconfig
menuconfig BR2_PACKAGE_BOOTHOOK_SELFPARTITION
	bool "Add extra data partitions"
	select BR2_PACKAGE_RAMFSINIT
	select BR2_PACKAGE_E2FSPROGS if BR2_RAMFSINIT_SDCARD
	select BR2_PACKAGE_E2FSPROGS_MKE2FS if BR2_RAMFSINIT_SDCARD
	select BR2_PACKAGE_MTD if BR2_RAMFSINIT_NAND
	select BR2_PACKAGE_MTD_UBIMKVOL if BR2_RAMFSINIT_NAND
	select BR2_PACKAGE_MTD_UBINFO if BR2_RAMFSINIT_NAND
	help
	  Create data partition for receiver state persistence.
	  The pre-boot hook script is generated and installed in 
	  the $BINARIES_DIR, and a matching fstab file is placed
	  in /etc.

	  https://outernet.is/

if BR2_PACKAGE_BOOTHOOK_SELFPARTITION

if BR2_RAMFSINIT_NAND

comment "Partition sizes are specified using U-boot environment"
comment "and must match the values specified below."

endif # BR2_RAMFSINIT_NAND


config BR2_BOOTHOOK_SELFPARTITION_CONFIG_SIZE
	string "Configuration partition size (MiB)"
	default 32
	help
	  Size of the system configuration partition. This 
	  partition stores persistent system configuration.

config BR2_BOOTHOOK_SELFPARTITION_CACHE_SIZE
	string "Cache partition size (MiB)"
	default 600
	help
	  Size of the download cache partition. This partition
	  is used to store the partial downloads.

config BR2_BOOTHOOK_SELFPARTITION_APPDATA_SIZE
	string "Application data partition size (MiB)"
	default 2048
	help
	  Size of the application data partition. This partition
	  stores application data such as databases, settings,
	  and similar.

endif # BR2_PACKAGE_BOOTHOOK_SELFPARTITION
```

## rxos/local/bsdiff-aosp/Config.in
```kconfig
config BR2_PACKAGE_BSDIFF_AOSP
	bool "bsdiff from aosp"
	select BR2_PACKAGE_BZIP2
	help
	  Binary patch/diff like xdelta but creates smaller diffs.
	  Needs bzip2 support. Only bspatch is supported on target.
	  This is the version developed by the AOSP project, it has much 
	  better performance and less than half the ram requirement

	  https://github.com/Outernet-Project/bsdiff-aosp
```

## rxos/local/cleanup/Config.in
```kconfig
config BR2_PACKAGE_CLEANUP
	bool "cleanup.sh"
	help
	  Script to clean up the content and free up space

	  https://outernet.is/
```

## rxos/local/cloop-arm-bin/Config.in
```kconfig
config BR2_PACKAGE_CLOOP_ARM_BIN
	bool "cloop image tools arm binaries for target"
	depends on BR2_cortex_a8
	help
	  Install cloop image tools arm binaries to target
```

## rxos/local/dropbear-init/Config.in
```kconfig
config BR2_PACKAGE_DROPBEAR_INIT
	bool "Use alternative dropbear init script"
	select BR2_PACKAGE_DROPBEAR
	help
	  Simple version of the dropbear init script.

	  The modified script removes the symlink handling 
	  in the upstream version so that it is compatible
	  with how rxOS persists configuration and state.

	  https://outernet.is/
```

## rxos/local/dtc-tools/Config.in
```kconfig
config BR2_PACKAGE_DTC_TOOLS
	bool "Install Binary device tree (dtb) editing tools"
	help
	  dtc-tools provide fdtget and fdtput that allow reading and writing values from/to dtb files
```

## rxos/local/fsal-config/Config.in
```kconfig
menuconfig BR2_PACKAGE_FSAL_CONFIG
	bool "fsal.ini"
	select BR2_PACKAGE_PYTHON_FSAL
	help
	  Configuration for FSAL.
	  
	  http://outernet.is/

if BR2_PACKAGE_FSAL_CONFIG

config BR2_FSAL_SOCKETPATH
	string "FSAL socket path"
	default "/var/run/fsal.ctrl"
	help
	  Path where FSAL will create its control 
	  socket.

config BR2_FSAL_BASEDIRS
	string "Base directories"
	default "/mnt/downloads/ /mnt/external/"
	help
	  Base directories for downloaded content.

config BR2_FSAL_LOGPATH
	string "Log file path"
	default "/mnt/data/log/fsal.log"
	help
	  Path to FSAL log file.

config BR2_FSAL_LOGSIZE
	string "Log file size limit"
	default "5M"
	help
	  Maximum size of the log file. The 
	  total size taken up by log files is 
	  (number of backups + 1) * this size.

config BR2_FSAL_LOGBACKUPS
    string "Number of backup log files to keep"
	default "2"
	help
	  Maximum number of backup log files 
	  (old entires) to keep in addition to
	  the main log file.

endif # BR2_PACKAGE_FSAL_CONFIG
```

## rxos/local/gserial/Config.in
```kconfig
config BR2_PACKAGE_GSERIAL
	bool "Enable support for gadget serial/network"
	help
	  Enable support for gadget serial

	  https://outernet.is/
```

## rxos/local/incron-service/Config.in
```kconfig
menuconfig BR2_PACKAGE_INCRON_SERVICE
    bool "inotify cron service"
    select BR2_PACKAGE_INOTIFY_TOOLS
    help
        incron service

if BR2_PACKAGE_INCRON_SERVICE

config BR2_INCRON_SERVICE_CONFDIR
    string "incron config dir"
    default "/etc/incron.d"
    help
      Absolute path to a directory to be watched for watch config.

endif
```

## rxos/local/led-control/Config.in
```kconfig
menuconfig BR2_PACKAGE_LED_CONTROL
    bool "led-control"
    help
      LED control library that allows control
      of a single on-board LED via the sysfs 
      interface.

if BR2_PACKAGE_LED_CONTROL

choice
	prompt "LED control method"
	default BR2_LED_CONTROL_SYSFS
	help
	  Method of controlling the LED(s).

config BR2_LED_CONTROL_SYSFS
	bool "sysfs"
	help
	  Use sysfs to controll the LED(s).

config BR2_LED_CONTROL_I2C
	bool "i2c"
	select BR2_PACKAGE_I2C_TOOLS
	help
	  User i2c-tools to controll the LED(s).

endchoice

config BR2_LED_CONTROL_METHOD
	string
	default "sysfs" if BR2_LED_CONTROL_SYSFS
	default "i2c" if BR2_LED_CONTROL_I2C

if BR2_LED_CONTROL_SYSFS

config BR2_LED_DEVNUM
	int "LED device number"
	default 0
	help
	  Number of the LED device.

	  For number N, the following LED device 
	  will be used:

	  /sys/class/leds/ledN

endif # BR2_LED_CONTROL_SYSFS

if BR2_LED_CONTROL_I2C

config BR2_LED_BUS
	int "LED device i2c bus"
	default 0
	help
	  Bus number

config BR2_LED_CHIP
	hex "LED device i2c chip ID"
	default 0x34
	help
	  Chip ID

config BR2_LED_ADDR
	hex "LED device i2c data address"
	default 0x93
	help
	  Data address

endif # BR2_LED_CONTROL_I2C

endif # BR2_PACKAGE_LED_CONTROL
```

## rxos/local/librarian-config/Config.in
```kconfig
menuconfig BR2_PACKAGE_LIBRARIAN_CONFIG
	bool "librarian.ini"
	select BR2_PACKAGE_PYTHON_LIBRARIAN
	select BR2_PACKAGE_FSAL_CONFIG
	help
	  Configuration for librarian.
	  
	  http://outernet.is/

if BR2_PACKAGE_LIBRARIAN_CONFIG

config BR2_LIBRARIAN_ADDR
	string "Bind address"
	default "127.0.0.1"
	help
	  Use 0.0.0.0 to make Librarian accessible
	  from outside or 127.0.0.1 make it only 
	  accept local connections (e.g., from the 
	  frontend HTTP server).

config BR2_LIBRARIAN_PORT
	string "Port"
	default "8000"
	help
	  Port Librarian will listen on.

config BR2_LIBRARIAN_DEFROUTE
	string "Default route"
	default "filemanager:list"
	help
	  Default route that will be used as an 
	  alias for root URL.

config BR2_LIBRARIAN_DEFROUTEARGS
	string "Default route arguments"
	default "path:"
	help
	  Default route arguments that will be passed
	  to the route constructor. It is a key-value
	  pair, separated by `:`.

config BR2_LIBRARIAN_LOGPATH
	string "Log file path"
	default "/mnt/data/log/librarian.log"
	help
	  Path to application log file.

config BR2_LIBRARIAN_LOGSIZE
	string "Log file size limit"
	default "5M"
	help
	  Maximum size of the log file. The 
	  total size taken up by log files is 
	  (number of backups + 1) * this size.

config BR2_LIBRARIAN_LOGBACKUPS
    string "Number of backup log files to keep"
	default "2"
	help
	  Maximum number of backup log files 
	  (old entires) to keep in addition to
	  the main log file.

config BR2_LIBRARIAN_SETTINGS_FILE
	string "Setting file path"
	default "/mnt/data/librarian/librarian.json"
	help
	  Path of the application settings file.

endif # BR2_PACKAGE_LIBRARIAN_CONFIG
```

## rxos/local/lighttpd-config/Config.in
```kconfig
menuconfig BR2_PACKAGE_LIGHTTPD_CONFIG
	bool "lighttpd.conf"
	select BR2_PACKAGE_LIGHTTPD_CUSTOM
	help
	  Install lighttpd configuration files in
	  /etc/lighttpd.

	  https://outernet.is/

if BR2_PACKAGE_LIGHTTPD_CONFIG

config BR2_LIGHTTPD_SERVER_ROOT
	string "Server root directory"
	default "/usr/html"
	help
	  Base diretory for static content.

config BR2_LIGHTTPD_SERVER_TAG
	string "Server name"
	default "rxOS/Lighttpd"
	help
	  Server name that appears in response
	  headers.

config BR2_LIGHTTPD_STATICDIR
    string "Static assets directory"
	default "/usr/lib/python2.7/site-packages/librarian/static/"
	help
	  Path to the directory containing the 
	  application static assets.

config BR2_LIGHTTPD_FAVICON
	string "Favicon location"
	default "img/favicon.ico"
	help
	  Path to the favicon file relative to
	  the static assets directory.

config BR2_LIGHTTPD_UPLOAD_LIMIT
	int "File upload size limit"
	default 125829120
	help
	  Maximum upload size in bytes.

config BR2_LIGHTTPD_UPLOAD_TMPDIR
	string "File upload temp path"
	default "/mnt/data"
	help
	  Directory for storing temporary files 
	  during upload.

endif # BR2_PACKAGE_LIGHTTPD_CUSTOM
```

## rxos/local/network-config/Config.in
```kconfig
menuconfig BR2_PACKAGE_NETWORK_CONFIG
	bool "Network configuration"
	select BR2_PACKAGE_DNSMASQ
	select BR2_PACKAGE_HOSTAPD
	select BR2_PACKAGE_IW
	select BR2_PACKAGE_BUSYBOX_SHOW_OTHERS
	select BR2_PACKAGE_DEBIANUTILS
	select BR2_PACKAGE_IFUPDOWN
	select BR2_PACKAGE_IPROUTE2
	select BR2_PACKAGE_IFPLUGD
	select BR2_PACKAGE_IPTABLES
	select BR2_PACKAGE_WPA_SUPPLICANT
	select BR2_PACKAGE_WPA_SUPPLICANT_NL80211
	select BR2_PACKAGE_WPA_SUPPLICANT_NL80211
	select BR2_PACKAGE_WPA_SUPPLICANT_CLI
	select BR2_PACKAGE_WPA_SUPPLICANT_PASSPHRASE
	help
	  Configuration and init scripts necessary to start a wireless hotspot.
	  
	  http://outernet.is/

if BR2_PACKAGE_NETWORK_CONFIG

config BR2_NETOWRK_CONFIG_HAS_ETH
    bool "Use Ethernet interface (DHCP)"
	help
	  Configure Ethernet interface eth0 with DHCP.

config BR2_NETWORK_CONFIG_HAS_GETH
	bool "Use gadget Ethernet interface (static)"
	help
	  Configure the gadget Ethernet interface (usb0)
	  with static IP address and DHCP server enabled
	  on it.

config BR2_NETWORK_CONFIG_AP_IF
	string "Access point interface"
	default "wlan0"
	help
	  Network interface name used for the access point.

config BR2_NETWORK_CONFIG_AP_NAME
	string "Access point name"
	default "Outernet"
	help
	  SSID used for the access point.

config BR2_NETWORK_CONFIG_AP_IP
	string "Access point IP address"
	default "10.0.0.1"
	help
	  IPv4 address of the access point.

config BR2_NETWORK_CONFIG_DHCP_START
	string "DHCP IP range start"
	default "10.0.0.100"
	help
	  Start of the IP range that will be assigned to clients.

config BR2_NETWORK_CONFIG_DHCP_END
	string "DHCP IP range end"
	default "10.0.0.254"
	help
	  End address of the IP range that will be assigned to clients.

config BR2_NETWORK_CONFIG_NETMASK
	string "DHCP subnet mask"
	default "255.255.255.0"
	help
	  Subnet used by clients.

config BR2_NETWORK_CONFIG_DHCP_LDIR
	string "DHCP leases directory"
	default "/var/run"
	help
	  Directory where dnsmasq will store the lease file.

config BR2_NETWORK_CONFIG_TAG
	string "Domain name"
	default "lan"
	help
	  Domain name used by the clients.

if BR2_NETWORK_CONFIG_HAS_GETH

config BR2_NETWORK_CONFIG_GETH_IP
	string "Gadget Ethernet IP address"
	default "10.10.10.10"
	help
	  IPv4 address of the access point.

config BR2_NETWORK_CONFIG_GETH_HOSTNAME
	string "Gadget Ethernet hostname"
	default "usb.rxos.com"
	help
	  Hostname to use in DNS resolution.

config BR2_NETWORK_CONFIG_GETH_DHCP_START
	string "Gadget Ethernet DHCP IP range start"
	default "10.10.10.100"
	help
	  Start of the IP range that will be assigned to clients.

config BR2_NETWORK_CONFIG_GETH_DHCP_END
	string "Gadget Ethernet DHCP IP range end"
	default "10.10.10.254"
	help
	  End address of the IP range that will be assigned to clients.

endif # BR2_NETWORK_CONFIG_HAS_GETH

config BR2_NETWORK_CONFIG_WLAN_NOPOWERSAVE
	bool "Disable power management for wifi0 interface"
	help
	  When this is enabled, power-saving is disabled for 
	  wifi0 interface.

endif
```

## rxos/local/nginx-config/Config.in
```kconfig
config BR2_PACKAGE_NGINX_CONFIG
	bool "nginx.conf"
	select BR2_PACKAGE_NGINX
	help
	  Install nginx configuration file at
	  /etc/nginx/nginx.conf.

	  https://outernet.is/
```

## rxos/local/opakwatch/Config.in
```kconfig
menuconfig BR2_PACKAGE_OPAKWATCH
	bool "opak file watcher and extractor"
	select BR2_PACKAGE_INOTIFY_TOOLS
	help
	  Install opakwatch tool and init script.

if BR2_PACKAGE_OPAKWATCH

config BR2_OPAKWATCH_SOURCE
	string "Source directory path to watch"
	help
	  Absolute path to a directory to be watched for new files.

config BR2_OPAKWATCH_DESTINATION
	string "Destination directory path where to extract opak archives"
	help
	  Absolute path to a directory where the archives will be extracted.

endif
```

## rxos/local/opakwatch2/Config.in
```kconfig
menuconfig BR2_PACKAGE_OPAKWATCH2
	bool "opak file handler - based on incron service"
	select BR2_PACKAGE_INCRON_SERVICE
	help
	  Install opakwatch2 incron config and script.

if BR2_PACKAGE_OPAKWATCH2

config BR2_OPAKWATCH2_SOURCE
	string "Source directory path to watch"
	default "/mnt/downloads/.opaks"
	help
	  Absolute path to a directory to be watched for new files.

config BR2_OPAKWATCH2_DESTINATION
	string "Destination directory path where to extract opak archives"
	default "/mnt/downloads"
	help
	  Absolute path to a directory where the archives will be extracted.

endif
```

## rxos/local/ota-pkg/Config.in
```kconfig
menuconfig BR2_PACKAGE_OTA_PKG
	bool "Build an OTA update package file"
	select BR2_PACKAGE_PKGTOOL
	select BR2_PACKAGE_HOST_PKGTOOL
	help
	  Build a .pkg file for performing OTA and 
	  USB stick updates.

if BR2_PACKAGE_OTA_PKG

config BR2_OTA_PKG_VERSIONLESS
	bool "Ignore installed firmware version"
	help
	  When this option is turned on, the installer
	  script will not check the version of the firmware
	  that is already installed. This will allow the 
	  new firmware to be installed regardless of 
	  whether the existing firmware is newer or older
	  than the one that is going to be installed.

	  When this option is off, only newer versions
	  can be installed.

config BR2_OTA_PKG_KEY
	string "Package signature key file"
	help
	  Specify a path to package key file that is used
	  to sign the package for OTA update verfication
	  on the receivers.

config BR2_OTA_PKG_PREINSTALL
	string "Pre-install script"
	help
	  Specify a path to a script that will be executed 
	  before installation.

config BR2_OTA_PKG_POSTINSTALL
	string "Post-install script"
	help
	  Specify a path to a script that will be executed
	  after installation.

endif # BR2_PACKAGE_OTA_PKG
```
