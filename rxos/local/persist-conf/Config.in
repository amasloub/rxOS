## rxos/local/persist-conf/Config.in
```kconfig
menuconfig BR2_PACKAGE_PERSIST_CONF
	bool "Persistent configuration"
	select BR2_PACKAGE_SETUP
	help
	  Add support for persistent configuration.

	  System files listed in $BR2_PERISTENT_CONF_LIST 
	  will be persisted in the writable directory
	  specified by $BR2_PERSISTENT_CONF_DIR and 
	  symlinked back to the original location.

if BR2_PACKAGE_PERSIST_CONF

config BR2_PERSISTENT_CONF_LIST
	string "Persistent configuration file list"
	help
	  Space-separated list of files and directories
	  to persist.

config BR2_PERSISTENT_CONF_DIR
	string "Persistent configuration directory"
	default "/mnt/conf"
	help
	  Directory where persistent configuration is
	  stored. This should be a directory under
	  a read-write mount point to be useful.

endif
```

## rxos/local/postgres-config/Config.in
```kconfig
menuconfig BR2_PACKAGE_POSTGRES_CONFIG
	bool "Postgres configuration"
	help 
	  Install a postgres init script with
	  build-specific configuration.

if BR2_PACKAGE_POSTGRES_CONFIG

config BR2_POSTGRES_DBDIR
	string "Database directory"
	default "/mnt/data/postgres"
	help
	  Location of the Postgres data directory

config BR2_POSTGRES_USER
	string "Postgres unprivileged user"
	default "postgres"
	help
	  Username under which postgres will run

endif # BR2_PACKAGE_POSTGRES_CONFIG
```

## rxos/local/ramfsinit/Config.in
```kconfig
menuconfig BR2_PACKAGE_RAMFSINIT
	bool "Create early userspace cpio archive"
	select BR2_TARGET_ROOTFS_INITRAMFS
	select BR2_INITRAMFS_USE_OTHER
	help
	  Creates the initial RAM filesystem image that can be
	  linked into the kernel. The compression option for the 
	  initial RAM filesystem image can be set in 
	  
	      Filesystem images > initial RAM... > Compression method

	  This package also adds a target-finalize hook which 
	  collects all cpio archive fragments added to 
	  $INIT_CPIO_LISTS variable and concatenates them into
	  a single file. If you wish to write packages that 
	  provide one-time boot hooks, you can add additional
	  content to the initiam RAM filesystem archvie by
	  appending to this list in the package's makefile.

	  https://outernet.is/


if BR2_PACKAGE_RAMFSINIT

choice
	prompt "Main storage device"
	default BR2_RAMFSINIT_NAND
	help
	  Create init script for a particular storage type.

config BR2_RAMFSINIT_NAND
	bool "NAND flash"
	help
	  The init script will assume NAND flash
	  main storage. (e.g., CHIP)

config BR2_RAMFSINIT_SDCARD
	bool "SD card"
	help
	  The init script will assume SD card
	  main storage. (e.g., Raspberry Pi)
	  
endchoice

config BR2_RAMFSINIT_INIT_TYPE
	string
	default "nand" if BR2_RAMFSINIT_NAND
	default "sdcard" if BR2_RAMFSINIT_SDCARD

endif # BR2_PACKAGE_RAMFSINIT
```

## rxos/local/remote-support/Config.in
```kconfig
config BR2_PACKAGE_REMOTE_SUPPORT
	bool "Remote support access"
	select BR2_PACKAGE_DROPBEAR_CLIENT
	help
	  Add support for remote reverse SSH access to
	  the system via a hub server.
```

## rxos/local/rxos-utils/Config.in
```kconfig
menuconfig BR2_PACKAGE_RXOS_UTILS
	bool "rxos-utils"
	select BR2_PACKAGE_LIBCURL
	select BR2_PACKAGE_CURL
	help
	  Set of command line tools for working with rxOS.

if BR2_PACKAGE_RXOS_UTILS

config BR2_RXOS_UTILS_INSTALL_CHIPGPIO
	bool "Install CHIP GPIO shell library"
	help
	  Install /usr/lib/chipgpio.sh which can be used to
	  read the status of GPIO pins.

config BR2_RXOS_UTILS_STORAGE
	string
	default "mmcblk0" if BR2_RAMFSINIT_SDCARD
	default "ubi0" if BR2_RAMFSINIT_NAND

config BR2_RXOS_UTILS_PARTITIONS
	string 
	default "p5 p6 p7 p8" if BR2_RAMFSINIT_SDCARD
	default ":linux :conf :data" if BR2_RAMFSINIT_NAND

config BR2_RXOS_UTILS_BOOTDEV
	string
	default "/dev/mmcblk0p1" if BR2_RAMFSINIT_SDCARD
	default "ubi0:linux" if BR2_RAMFSINIT_NAND

config BR2_RXOS_UTILS_PROCS
	string "Processes"
	default "hostapd dnsmasq dropbear ondd sdr100 node multifs"
	help
	  The processes whose status is checked.

config BR2_RXOS_UTILS_IFACES
	string "Network interfaces"
	default "wlan0 usb0"
	help
	  Network interfaces to check.

config BR2_RXOS_UTILS_HOSTS
	string "Host services"
	default "Application:http:8000 HTTP:http:80; FTP:ftp:21"
	help
	  Local network services to check. The list is
	  space-separated where each item has three
	  parts in the following format:

	      <label>:<protocol>:<port>

config BR2_RXOS_UTILS_DEVNODES
	string "Device nodes"
	help
	  Space-separate list of device nodes to check.
	  Note that storage device node is always checked.

config BR2_RXOS_UTILS_EXTRA_PATH
	string "Additional PATH"
	help
	  When looking up processes, add the following to PATH.
	  Should be a colon-separated list of path.

endif  # BR2_PACKAGE_RXOS_UTILS
```

## rxos/local/sd-image/Config.in
```kconfig
config BR2_PACKAGE_SD_IMAGE
	bool "Create SD image"
    select BR2_TARGET_ROOTFS_ISOROOT
    select BR2_PACKAGE_HOST_DIR2FAT32
	help
	  Create SD image containing all relevant
	  board partitions.
```

## rxos/local/sdimage/Config.in
```kconfig
menuconfig BR2_PACKAGE_SDIMAGE
	bool "Build SD card image"
	select BR2_PACKAGE_HOST_DIR2FAT32
	help
	  Build and SD card image containing the boot files
	  (bootloader, firmware, kernel image, rootfs images).

if BR2_PACKAGE_SDIMAGE

config BR2_SDIMAGE_FILE
	string "Output filename"
	default "sdcard.img"
	help
	  Name of the output image file. The file will
	  be stored in the $BINARIES_DIR.
    
config BR2_SDIMAGE_SIZE
	int "Boot partition size in MiB"
	default 200
	help
	  Size of the FAT32 partition that will store the 
	  boot files.

config BR2_SDIMAGE_SOURCE
	string "File containing the file list for SD card image"
	help
	  The file should be in the following format:

		  source_path:target_path

	  The source_path points to the file within the 
	  $BINARIES_DIR, and the target_path points to the
	  intended path within the SD card.

endif # BR2_PACKAGE_SDIMAGE
```

## rxos/local/sdr-config/Config.in
```kconfig
menuconfig BR2_PACKAGE_SDR_CONFIG
	bool "SDR init script and configuration"
	help
	  Install SDR demodulator configuration and 
	  init script.


if BR2_PACKAGE_SDR_CONFIG

config BR2_SDR_BINARY_PATH
	string "Path to demodulator executable"
	default "/usr/sbin/sdr100"
	help
	  Absolute path to where demodulator executable
	  file would be.

endif
```

## rxos/local/setup/Config.in
```kconfig
config BR2_PACKAGE_SETUP
	bool "Perform initial system setup"
	help
	  Execute arbitrary scripts found in 
	  /etc/setup.d during init.
```

## rxos/local/sop-handler/Config.in
```kconfig
menuconfig BR2_PACKAGE_SOP_HANDLER
	bool "process Skylark OTA packages"
	depends on BR2_PACKAGE_TWEETNACL_TOOLS
	help
	  watches for sop files and processes them

if BR2_PACKAGE_SOP_HANDLER

config BR2_SOP_HANDLER_SOURCE
	string "Source directory path to watch"
	default "/mnt/downloads/.sop"
	help
	  Absolute path to a directory to be watched for new sop files.

config BR2_SOP_SIGN_PUBKEY_PATH
	string "sop verfication public key path"
	default "/etc/outernet/sop.pubkey"
	help
        directory where the sop verification key is kept

endif
```

## rxos/local/starsdr-arm/Config.in
```kconfig
config BR2_PACKAGE_STARSDR_ARM
	bool "Install starsdr and demod binaries for arm"
	depends on BR2_cortex_a8
	help
	  starsdr and demod binaries for arm
```

## rxos/local/storage-hotplug/Config.in
```kconfig
config BR2_PACKAGE_STORAGE_HOTPLUG
	bool "Storage hotplugging"
	depends on BR2_PACKAGE_EUDEV
	select BR2_PACKAGE_NTFS_3G
	select BR2_PACKAGE_DOSFSTOOLS
	select BR2_PACKAGE_DOSFSTOOLS_FSCK_FAT
	select BR2_PACKAGE_E2FSPROGS
	select BR2_PACKAGE_E2FSPROGS_FSCK
	select BR2_PACKAGE_E2FSPROGS_E2FSCK
	select BR2_PACKAGE_LED_CONTROL
	help
	  Enable storage hotplugging.


if !BR2_PACKAGE_EUDEV
comment "Storage hotplug depends on eudev"
endif
```

## rxos/local/tweetnacl-tools/Config.in
```kconfig
config BR2_PACKAGE_TWEETNACL_TOOLS
	bool "Install Tweetnacl tools"
	help
	  Tweetnacl tools are command line tools for ECC crypto
```

## rxos/local/ubi-image/Config.in
```kconfig
config BR2_PACKAGE_UBI_IMAGE
	bool "Create UBI image"
	select BR2_TARGET_ROOTFS_ISOROOT
	help
	  Create UBI image containing all relevant
	  board partitions in the forum of UBI
	  volumes.
```

## rxos/local/ubihealthd/Config.in
```kconfig
config BR2_PACKAGE_UBIHEALTHD
	bool "ubihealthd service for MLC nand"
	depends on BR2_PACKAGE_MTD_MLC_UBIHEALTHD
	help
	  Install ubihealthd service
```

## rxos/local/ui2/Config.in
```kconfig
config BR2_PACKAGE_UI2
	bool "Install RxOS UI2 package"
	select BR2_PACKAGE_NODEJS
	help
	  UI2 is the main UI for RxOS
```

## rxos/local/ui2service/Config.in
```kconfig
config BR2_PACKAGE_UI2SERVICE
	bool "UI2 service"
	select BR2_PACKAGE_UI2
	help
	  Install UI2 init script.
```

## rxos/local/vsftpd-rxos/Config.in
```kconfig
config BR2_PACKAGE_VSFTPD_RXOS
	bool "vsftpd for rxos"
	depends on BR2_USE_MMU # fork()
	help
	  vsftpd is an ftp daemon written with security in mind.
	  this package is a customied version of the mainline vsftpd package
	  http://vsftpd.beasts.org/
```

## rxos/local/weathergen/Config.in
```kconfig
menuconfig BR2_PACKAGE_WEATHERGEN
	bool "generates weather json files from grib files"
	select BR2_PACKAGE_WGRIB2BIN
	help
	  watches for grib files and generates json data from them

if BR2_PACKAGE_WEATHERGEN

config BR2_WEATHERGEN_SOURCE
	string "Source directory path to watch"
	default "/mnt/downloads/grib2"
	help
	  Absolute path to a directory to be watched for new files.

config BR2_WEATHERGEN_JSON_DESTINATION
	string "Destination directory path where json will be saved"
	default "/mnt/downloads/Weather/data/weather"
	help
	  Absolute path to a directory where weather files will be saved

config BR2_WEATHERGEN_GRIB_DESTINATION
	string "Destination directory path where processed gribs will be saved"
	default "/mnt/downloads/Weather/grib2"
	help
	  Absolute path to a directory where grib2 will be saved

endif
```

## rxos/local/wgrib2/Config.in
```kconfig
menuconfig BR2_PACKAGE_WGRIB2
	bool "wgrib2 grib2 file processor binary"
	help
	  wgrib2 file processor, built from source
```

## rxos/local/wgrib2bin/Config.in
```kconfig
menuconfig BR2_PACKAGE_WGRIB2BIN
	bool "wgrib2 grib2 file processor binary"
	depends on BR2_cortex_a8
	help
	  Install wgrib2 file processor binary
```
